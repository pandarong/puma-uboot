/*
 * (C) 2017 Theobroma Systems Design und Consulting GmbH
 *
 * SPDX-License-Identifier:     GPL-2.0+
 */

&dmc {
	theobroma-systems,spd = /bits/ 8 <
		0x01 /* CRC covers 0~127, 128 bytes data */
		0x10 /* revision level 1.0 */
		0x0b /* DDR3 SDRAM */
		0x00 /* module-specific section (bytes 60 ~ 116): undefined */
		0x35 /* 8 banks, 8 Gb devices */
		0x21 /* 16 rows, 10 columns */
		0x03 /* 1.35V and 1.5V operable */
		0x02 /* 1 rank, x16 device-width */
		0x02 /* 32 bit (primary) bus-width */
		0x11 /* fine timebase: 1/1 = 1ps */
		0x01 /* medium timebase dividend */
		0x08 /* medium timebase divisor */
		0x09 /* tCKmin(MTB) .. DDR-1866 */
		0x00 /* */
		0x54 /* CAS supported: CL=10, CL=8, CL=6 */
		0x02 /* CAS supported: CL=13 */
		0x70 /* tAAmin(MTB) */
		0x78 /* tWRmin(MTB) */
		0x70 /* tRCDmin(MTB) */
		0x30 /* tRRDmin(MTB): 6.0 ns */
		0x70 /* tRPmin(MTB) */
		0x11 /* upper nibble for tRC (bits 7~4) and tRAS bits (3~0) */
		0x10 /* tRASmin(MTB), LSB */
		0x80 /* tRCmin(MTB), LSB */
		0xF0 /* tRFCmin(MTB), LSB */
		0x0A /* tRFCmin(MTB), MSB */
		0x3C /* tWTRmin(MTB) */
		0x3C /* tRTPmin(MTB) */
		0x01 /* upper nibble for tFAWmin */
		0x18 /* tFAWmin(MTB), LSB */
		0x00 /* optional features: no DLL-Off, no RZQ/7, no RZQ/6 */
		0x05 /* thermal/refresh: ASR, 85-95 @ 2x refresh, 0-95 degC */
		0x00 /* no thermal sensor */
		0x10 /* stacking/signal-loading: not specified */
		0xca /* tCKmin(FTB) */
		0xa6 /* tAAmin(FTB) */
		0xa6 /* tRCDmin(FTB) */
		0xa6 /* tRPmin(FTB) */
		0xa6 /* tRCmin */
		0x00 /* MAC: tMAW = 8192*tREFI, untested MAC */
	>;

        rockchip,sdram-params = <
		0x1
		0xa
		0x3
		0x2
		0x1
		0x0
		0x10
		0x10
		1
		0x80181219
		0x17050a03
		0x00000002
		0x00006456
		0x0000004c
		0x00000000
		0x1
		0xa
		0x3
		0x2
		0x1
		0x0
		0x10
		0x10
		1
		0x80181219
		0x17050a03
		0x00000002
		0x00006456
		0x0000004c
		0x00000000
		933
		3
		2
		13
		1
		0x00000600 /* !0  DRAM_CLASS START */
		0x00000000
		0x00000000
		0x00000000
		0x00000000
		0x0000000a /* +5   f0 _params_f0 */
		0x00000000 /* +6 */
		0x00000000 /* ?7 tinit4 */
		0x00000000 /* +8 tinit5 __params_f0 */
		0x0000000a /* 9   f1 */
		0x00000000
		0x00000000
		0x00000000
		0x0000000a /* 13  f2 */
		0x00000000
		0x00000000
		0x01000000 /* 16  f2 */
		0x00000000
		0x00000101 /* !18  NO_PHY_IND_TRAIN_INIT
			      	   PHY_INDEP_TRAIN_MODE */
		0x00020100 /* !19  dfi bus frequencies */
		0x0002d976 /* !20  TRST_PWRO timing: 200us? 200ns? */
			   /*      0x0002d976*(1.0/933) = 200.15219721329044 */
		0x00071fa6 /* !21  CKE_INACTIVE: 500 */
			   /*      0x00071fa6*(1.0/933) = ~500 */
		0x02000200 /* +22  f0 f1 _ctl_params_f? */
		0x091a0200 /* +23  f0 f2 _ctl_params_f? */
		0x00091a00 /* +24  */
		0x0400091a /* !25   TBST_INT_INTERVAL */
		0x2c060004 /* +26  _ctl_params_f0 */
		0x210c0820 /* +27  _ctl_params_f0 */
		0x202c0600 /* ?28  CA_DEFAULT_VAL_F0 (default is ok!), f1 */
		0x00210c08 /* ?29  CA_DEFAULT_VAL_F1, f1 */
		0x08202c06 /*  30  f2 */
		0x0800210c /* +31  _ctl_params_f0 f2 */
		0x00000f04 /* +32  _ctl_params_f0 */
		0x0501000a /* +33  _ctl_params_f0 */
		0x0f040805 /* +34  _ctl_params_f0 f1 */
		0x0501000a /*  35  f1 */
		0x0f040805 /*  36  f1 f2 */
		0x0501000a /*  37  f2 */
		0x02030005 /* !38  TPPD (LPDDR4-only?) TCKESR_F2 */
		0x0c0f0c00 /* +39  f1 _ctl_params_f0 WRITEINTERP (default) */
		0x000f0c0f /* ?40  TMRR (default) f1 f2 */
		0x14000a0a /* !41  TCACKEL TCAENT TCAMRD */
		0x00000a0a /* !42  (tmrz:_ctl_params_f0) f1 TCACKEH TCAEXT */
		0x00010000 /* !43  CONCURRENTAP f2 */
		0x031c1c1c /* !44  BSTLEN tDAL (f0..f2) */
		0x000c0c0c /* +45  tRP (f0..f2) */
		0x00000000 /* ?46  NO_MEMORY_DM ADDRESS_MIRRORING */
		0x03010000 /* !47  RESERVED = 3 ??? TREF_ENABLE */
		0x1c6a0147 /* +48  TREF/TRFC f0 */
		0x1c6a0147 /*  49  f1 */
		0x1c6a0147 /*  50  f2 */
		0x00000000 /* ?51  TREF_INTERVAL */
		0x00060006 /* +52  TPDEX f0 f1 */
		0x00170006 /* +53  TPDEX f2 TPDLL f0 */
		0x00170017 /*  54  TPDLL f1 f2 */
		0x00000000 /* +55  _ctl_params_f0 f1 f2 */
		0x00000000 /* +56  _ctl_params_f0 */
		0x00000000 /*  57  f1 */
		0x00000000 /*  58  f1 f2 */
		0x02000000 /* +59  f0 f1 f2 */
		0x02000151 /* +60  */
		0x02000151 /*  61  */
		0x00000151 /* +62  */
		0x00000000 /* +63  */
		0x00000000 /* +64  */
		0x00000000 /*  65  */
		0x00000000 /*  66  */
		0x00000000 /*  67  */
		0x00000000 /* !68  PWRUP_SREFRESH_EXIT */
		0x00000301 /* !69  CKE_DELAY = 3; ENABLE_QUICK_SREFRESH = 1 */
		0x00000001 /* ?70  training (ATF: rk3399_enable_training) */
		0x00000000 /* ?71  =same= */
		0x00000000
		0x01000000 /* ?73  reserved = 1 ??? */
		0x80104002 /* ?74  reserved */
		0x00040003 /* !75  DFI control update f0 */
		0x00040005 /* !76  more DFI control update f0 */
		0x00030000 /* !77  f0 f1 */
		0x00050004 /*  78  f1 */
		0x00000004 /*  79  f1 */
		0x00040003 /*  80  f2 */
		0x00040005 /*  81  f2 */
		0x71a80000 /* +82  f2 TDFI_PHYMSTR_MAX_F0 = 0x71a8 */
		0x000038d4 /* +83  */
		0x38d471a8 /*  84  f1 */
		0x71a80000 /*  85  f2 */
		0x000038d4 /*  86  f2 */
		0x00000000
		0x00000000
		0x00000000
		0x00000000
		0x00000000
		0x0a0a0a00 /* +92 */
		0x000a0a0a
		0x00030200
		0x00040700
		0x00000302
		0x02000407
		0x00000003
		0x00030f04
		0x00070004         /* 100 */
		0x00000000
		0x00000000
		0x00000000
		0x00000000
		0x00000000
		0x00000000
		0x00010000
		0x00010000
		0x20040020
		0x00200400         /* 110 */
		0x01000400
		0x00000b80
		0x00000000
		0x00000001
		0x00000002
		0x0000000e
		0x00000000
		0x00000000
		0x00000000
		0x00000000         /* 120 */
		0x00000000
		0x00bb0000
		0x00ea005e         /* 123 */
		0x00ea0000
		0x005e00bb
		0x000000ea         /* 126 */
		0x00bb00ea
		0x00ea005e
		0x00ea0000
		0x00000000
		0x00000000
		0x00000000
		0x00420014
		0x00140020
		0x00200042
		0x00420014
		0x00000020
		0x00000000
		0x00000000
		0x00000000
		0x00000000
		0x00000000
		0x00000000
		0x00000000
		0x00000000
		0x00000000
		0x00420014
		0x00140020
		0x00200042
		0x00420014
		0x00000020
		0x00000000
		0x00000000
		0x00000000
		0x00000000
		0x00000000
		0x00000000
		0x00000000
		0x00000000
		0x00000000
		0x01000000
		0x00000000
		0x00000000
		0x18151100
		0x0000000c
		0x00000000
		0x00000000
		0x00000000
		0x00000000
		0x00000000
		0x00000000
		0x00000000
		0x00000000
		0x00000000
		0x00000000
		0x00000000
		0x00000000
		0x00000000
		0x00025603
		0x004b012b
		0x00000000
		0x012b0256
		0x0000004b
		0x00025600
		0x004b012b
		0x00000000
		0x00000000
		0x00000000
		0x01010100
		0x00000202
		0x0a000001
		0x01000f0f
		0x00000000
		0x00000000
		0x00010003
		0x00000c03
		0x00000000
		0x00000000
		0x01000000
		0x00010000
		0x00000001
		0x00000000
		0x00000000
		0x00000000
		0x00000000
		0x00000000
		0x00000000
		0x00000000
		0x00000000
		0x00000000
		0x00010000
		0x08080802
		0x01010606
		0x00000001
		0x04040400
		0x03080808
		0x03050303
		0x03050303
		0x00050303
		0x00020202
		0x00000000
		0x00000000
		0x00000000
		0x00000000
		0x0d000001
		0x00010028
		0x00010000
		0x00000003
		0x00000000
		0x00000000
		0x00000000
		0x00000000
		0x00000000
		0x00000000
		0x00000000
		0x00000000
		0x00010100
		0x01000000
		0x00000001
		0x00000303
		0x00000000
		0x00000000
		0x00000000
		0x00000000
		0x00000000
		0x00000000
		0x00000000
		0x00000000
		0x00000000
		0x00000000
		0x00000000
		0x00000000
		0x00000000
		0x00000000
		0x00000000
		0x000556aa
		0x000aaaaa
		0x000aa955
		0x00055555
		0x000b3133
		0x0004cd33
		0x0004cecc
		0x000b32cc
		0x00010300
		0x03000100
		0x00000000
		0x00000000
		0x00000000
		0x00000000
		0x00000000
		0x00000000
		0x00000000
		0x00000000
		0x00ffff00
		0x15150000
		0x08000015
		0x000038d4
		0x00000200
		0x00000200
		0x00000200
		0x00000200
		0x000038d4
		0x00023848
		0x38d4080b
		0x00000200
		0x00000200
		0x00000200
		0x00000200
		0x000038d4
		0x00023848
		0x38d4080b
		0x00000200
		0x00000200
		0x00000200
		0x00000200
		0x000038d4
		0x00023848
		0x0202080b
		0x03030202
		0x00000014
		0x00000000
		0x00000000
		0x00001403
		0x00000000
		0x00000000
		0x00000000
		0x00030000
		0x00060018
		0x00060018
		0x00060018
		0x00000000
		0x00000000
		0x01000000
		0x03080308
		0x00050308
		0x00000000
		0x00000000
		0x00000000
		0x00000000
		0x00000000
		0x00000000
		0x00000000
		0x00000000
		0x01000100
		0x01010101
		0x01000101
		0x01000100
		0x00010001
		0x00010002
		0x00020100
		0x00000002
		0x00000600
		0x00000000
		0x000071a8
		0x000038d4
		0x000071a8
		0x000038d4
		0x000071a8
		0x38d438d4
		0x00000200
		0x00000200
		0x00000200
		0x00000200
		0x000038d4
		0x00000200
		0x00000200
		0x00000200
		0x00000200
		0x000038d4
		0x00000200
		0x00000200
		0x00000200
		0x00000200
		0x00010000
		0x00000007
		0x110f0001
		0x3c020000
		0x3fffffff
		0x3c030000
		0x1dc0ffff
		0x3c010000
		0x1dc0ffff
		0x3c000000
		0x1dc0ffff
		0x3c300400
		0x1dc7ffff
		0x3c000000
		0x00000000
		0x3c000000
		0x00000000
		0x3c000000
		0x00000000
		0x03000101
		0x00262626
		0x091a0009
		0x00091a00
		0x0000001a
		0x1c6a0147
		0x1c6a0147
		0x1c6a0147
		0x00000500
		0x00000000
		0x00000000
		0x00000000
		0x00000000
		0x00000000
		0x00000000
		0x00000000
		0x00000000
		0x04040000
		0x0d000004
		0x00000128
		0x00000000
		0x00030003
		0x00000014
		0x00000000
		0x00000000
		0x08060002
		0x08010801
		0x00060601
		0x00020001
		0x00080004
		0x00000000
		0x00000000
		0x04040400
		0x00000000
		0x00000000
		0x00000000
		0x00030300
		0x00000014
		0x00000000
		0x01010300
		0x00000000
		0x00000000
		0x01000000
		0x00000101
		0x55555a5a
		0x55555a5a
		0x55555a5a
		0x55555a5a
		0x0b0b0001
		0x0808000b
		0x03030008
		0x00000103
		0x00030000
		0x17030000
		0x00060018
		0x00060018
		0x00060018
		0x00000000
		0x00000000
		0x00000000
		0x140a0000
		0x000a000a
		0x00000a00
		0x010a000a
		0x00000100
		0x01000000
		0x00000000
		0x00000100
		0x1e1a0000
		0x10010204
		0x07070705
		0x20000202
		0x00201000
		0x00201000
		0x04041000
		0x12120100
		0x00010112
		0x004b004a
		0x1a030000
		0x0102041e
		0x34000000
		0x00000000
		0x00000000
		0x00000000
		0x00004200
		0x00000020
		0x004d4d00
		0x00200042
		0x4d000000
		0x0000424d
		0x00000020
		0x004d4d00
		0x00200042
		0x4d000000
		0x0000424d
		0x00000020
		0x004d4d00
		0x00200042
		0x4d000000
		0x0042004d
		0x00000020
		0x004d4d00
		0x00200042
		0x4d000000
		0x0000424d
		0x00000020
		0x004d4d00
		0x00200042
		0x4d000000
		0x0000424d
		0x00000020
		0x004d4d00
		0x00200042
		0x4d000000
		0x0000004d
		0x00ea00ea
		0x080400ea
		0x0f080c0c
		0x2000fd7a
		0x0a042000
		0x0c0c080f
		0x00000f08
		0x2000fd7a
		0x0a042000
		0x0c0c080f
		0x00000f08
		0x2000fd7a
		0x0a042000
		0x0200020f
		0x02000200
		0x02000200
		0x02000200
		0x02000200
		0x00000000
		0x00000000
		0x00000000
		0x00000000
		0x00000000
		0x00000000
		0x00000000
		0x00000000
		0x00000000
		0x00000000
		0x00000000
		0x00000000
		0x01000300
		0x0038d400
		0x00023848
		0x000038d4
		0x00023848
		0x000038d4
		0x00023848
		0x08000000
		0x00000100
		0x00000000
		0x00000000
		0x00000000
		0x00000000
		0x00000001
		0x76543210
		0x0004c008
		0x000000de
		0x00000000
		0x00000000
		0x00010000
		0x01665555
		0x00665555
		0x00010f00
		0x06010200
		0x00000001
		0x001700c0
		0x00cc0001
		0x00000066
		0x00000000
		0x00000000
		0x00000000
		0x00000000
		0x00000000
		0x00000000
		0x00000000
		0x00000000
		0x04080000
		0x04080400
		0x08000000
		0x0c00c007
		0x00000100
		0x00000100
		0x55555555
		0xaaaaaaaa
		0x55555555
		0xaaaaaaaa
		0x00005555
		0x00000000
		0x00000000
		0x00000000
		0x00000000
		0x00000000
		0x00000000
		0x00000000
		0x00000000
		0x00000000
		0x00000000
		0x00000000
		0x00000000
		0x00000000
		0x00000000
		0x00000000
		0x00000000
		0x00000000
		0x00000000
		0x00000000
		0x00200000
		0x00000000
		0x00000000
		0x00000000
		0x00000000
		0x00000000
		0x00000000
		0x02800280
		0x02800280
		0x02800280
		0x02800280
		0x00000280
		0x00000000
		0x00000000
		0x00000000
		0x00000000
		0x00800000
		0x00800080
		0x00800080
		0x00800080
		0x00800080
		0x00800080
		0x00800080
		0x00800080
		0x00800080
		0x00de0080
		0x00000001
		0x00000000
		0x00000000
		0x00000200
		0x00000000
		0x51313152
		0x80013130
		0x02000080
		0x00100001
		0x07064208
		0x000f0c0f
		0x01000140
		0x00000c20
		0x00000000
		0x00000000
		0x00000000
		0x00000000
		0x00000000
		0x00000000
		0x00000000
		0x00000000
		0x00000000
		0x00000000
		0x00000000
		0x00000000
		0x00000000
		0x00000000
		0x00000000
		0x00000000
		0x00000000
		0x00000000
		0x00000000
		0x00000000
		0x00000000
		0x00000000
		0x00000000
		0x00000000
		0x00000000
		0x00000000
		0x00000000
		0x00000000
		0x00000000
		0x00000000
		0x00000000
		0x00000000
		0x00000000
		0x00000000
		0x00000000
		0x00000000
		0x00000000
		0x76543210
		0x0004c008
		0x000000de
		0x00000000
		0x00000000
		0x00010000
		0x01665555
		0x00665555
		0x00010f00
		0x06010200
		0x00000001
		0x001700c0
		0x00cc0001
		0x00000066
		0x00000000
		0x00000000
		0x00000000
		0x00000000
		0x00000000
		0x00000000
		0x00000000
		0x00000000
		0x04080000
		0x04080400
		0x08000000
		0x0c00c007
		0x00000100
		0x00000100
		0x55555555
		0xaaaaaaaa
		0x55555555
		0xaaaaaaaa
		0x00005555
		0x00000000
		0x00000000
		0x00000000
		0x00000000
		0x00000000
		0x00000000
		0x00000000
		0x00000000
		0x00000000
		0x00000000
		0x00000000
		0x00000000
		0x00000000
		0x00000000
		0x00000000
		0x00000000
		0x00000000
		0x00000000
		0x00000000
		0x00200000
		0x00000000
		0x00000000
		0x00000000
		0x00000000
		0x00000000
		0x00000000
		0x02800280
		0x02800280
		0x02800280
		0x02800280
		0x00000280
		0x00000000
		0x00000000
		0x00000000
		0x00000000
		0x00800000
		0x00800080
		0x00800080
		0x00800080
		0x00800080
		0x00800080
		0x00800080
		0x00800080
		0x00800080
		0x00de0080
		0x00000001
		0x00000000
		0x00000000
		0x00000200
		0x00000000
		0x51313152
		0x80013130
		0x02000080
		0x00100001
		0x07064208
		0x000f0c0f
		0x01000140
		0x00000c20
		0x00000000
		0x00000000
		0x00000000
		0x00000000
		0x00000000
		0x00000000
		0x00000000
		0x00000000
		0x00000000
		0x00000000
		0x00000000
		0x00000000
		0x00000000
		0x00000000
		0x00000000
		0x00000000
		0x00000000
		0x00000000
		0x00000000
		0x00000000
		0x00000000
		0x00000000
		0x00000000
		0x00000000
		0x00000000
		0x00000000
		0x00000000
		0x00000000
		0x00000000
		0x00000000
		0x00000000
		0x00000000
		0x00000000
		0x00000000
		0x00000000
		0x00000000
		0x00000000
		0x76543210
		0x0004c008
		0x000000de
		0x00000000
		0x00000000
		0x00010000
		0x01665555
		0x00665555
		0x00010f00
		0x06010200
		0x00000001
		0x001700c0
		0x00cc0001
		0x00000066
		0x00000000
		0x00000000
		0x00000000
		0x00000000
		0x00000000
		0x00000000
		0x00000000
		0x00000000
		0x04080000
		0x04080400
		0x08000000
		0x0c00c007
		0x00000100
		0x00000100
		0x55555555
		0xaaaaaaaa
		0x55555555
		0xaaaaaaaa
		0x00005555
		0x00000000
		0x00000000
		0x00000000
		0x00000000
		0x00000000
		0x00000000
		0x00000000
		0x00000000
		0x00000000
		0x00000000
		0x00000000
		0x00000000
		0x00000000
		0x00000000
		0x00000000
		0x00000000
		0x00000000
		0x00000000
		0x00000000
		0x00200000
		0x00000000
		0x00000000
		0x00000000
		0x00000000
		0x00000000
		0x00000000
		0x02800280
		0x02800280
		0x02800280
		0x02800280
		0x00000280
		0x00000000
		0x00000000
		0x00000000
		0x00000000
		0x00800000
		0x00800080
		0x00800080
		0x00800080
		0x00800080
		0x00800080
		0x00800080
		0x00800080
		0x00800080
		0x00de0080
		0x00000001
		0x00000000
		0x00000000
		0x00000200
		0x00000000
		0x51313152
		0x80013130
		0x02000080
		0x00100001
		0x07064208
		0x000f0c0f
		0x01000140
		0x00000c20
		0x00000000
		0x00000000
		0x00000000
		0x00000000
		0x00000000
		0x00000000
		0x00000000
		0x00000000
		0x00000000
		0x00000000
		0x00000000
		0x00000000
		0x00000000
		0x00000000
		0x00000000
		0x00000000
		0x00000000
		0x00000000
		0x00000000
		0x00000000
		0x00000000
		0x00000000
		0x00000000
		0x00000000
		0x00000000
		0x00000000
		0x00000000
		0x00000000
		0x00000000
		0x00000000
		0x00000000
		0x00000000
		0x00000000
		0x00000000
		0x00000000
		0x00000000
		0x00000000
		0x76543210
		0x0004c008
		0x000000de
		0x00000000
		0x00000000
		0x00010000
		0x01665555
		0x00665555
		0x00010f00
		0x06010200
		0x00000001
		0x001700c0
		0x00cc0001
		0x00000066
		0x00000000
		0x00000000
		0x00000000
		0x00000000
		0x00000000
		0x00000000
		0x00000000
		0x00000000
		0x04080000
		0x04080400
		0x08000000
		0x0c00c007
		0x00000100
		0x00000100
		0x55555555
		0xaaaaaaaa
		0x55555555
		0xaaaaaaaa
		0x00005555
		0x00000000
		0x00000000
		0x00000000
		0x00000000
		0x00000000
		0x00000000
		0x00000000
		0x00000000
		0x00000000
		0x00000000
		0x00000000
		0x00000000
		0x00000000
		0x00000000
		0x00000000
		0x00000000
		0x00000000
		0x00000000
		0x00000000
		0x00200000
		0x00000000
		0x00000000
		0x00000000
		0x00000000
		0x00000000
		0x00000000
		0x02800280
		0x02800280
		0x02800280
		0x02800280
		0x00000280
		0x00000000
		0x00000000
		0x00000000
		0x00000000
		0x00800000
		0x00800080
		0x00800080
		0x00800080
		0x00800080
		0x00800080
		0x00800080
		0x00800080
		0x00800080
		0x00de0080
		0x00000001
		0x00000000
		0x00000000
		0x00000200
		0x00000000
		0x51313152
		0x80013130
		0x02000080
		0x00100001
		0x07064208
		0x000f0c0f
		0x01000140
		0x00000c20
		0x00000000
		0x00000000
		0x00000000
		0x00000000
		0x00000000
		0x00000000
		0x00000000
		0x00000000
		0x00000000
		0x00000000
		0x00000000
		0x00000000
		0x00000000
		0x00000000
		0x00000000
		0x00000000
		0x00000000
		0x00000000
		0x00000000
		0x00000000
		0x00000000
		0x00000000
		0x00000000
		0x00000000
		0x00000000
		0x00000000
		0x00000000
		0x00000000
		0x00000000
		0x00000000
		0x00000000
		0x00000000
		0x00000000
		0x00000000
		0x00000000
		0x00000000
		0x00000000
		0x00000000
		0x00800000
		0x00000000
		0x00000000
		0x00000000
		0x00000000
		0x00000000
		0x00000000
		0x00000000
		0x00000000
		0x00000000
		0x00400320
		0x00000040
		0x00dcba98
		0x00000000
		0x00dcba98
		0x01000000
		0x00020003
		0x00000000
		0x00000000
		0x00000000
		0x0000002a
		0x00000015
		0x00000015
		0x0000002a
		0x00000033
		0x0000000c
		0x0000000c
		0x00000033
		0x0a418820
		0x103f0000
		0x0000003f
		0x00030055
		0x03000300
		0x03000300
		0x00000300
		0x42080010
		0x00000003
		0x00000000
		0x00000000
		0x00000000
		0x00000000
		0x00000000
		0x00000000
		0x00000000
		0x00000000
		0x00000000
		0x00000000
		0x00000000
		0x00000000
		0x00000000
		0x00000000
		0x00000000
		0x00000000
		0x00000000
		0x00000000
		0x00000000
		0x00000000
		0x00000000
		0x00000000
		0x00000000
		0x00000000
		0x00000000
		0x00000000
		0x00000000
		0x00000000
		0x00000000
		0x00000000
		0x00000000
		0x00000000
		0x00000000
		0x00000000
		0x00000000
		0x00000000
		0x00000000
		0x00000000
		0x00000000
		0x00000000
		0x00000000
		0x00000000
		0x00000000
		0x00000000
		0x00000000
		0x00000000
		0x00000000
		0x00000000
		0x00000000
		0x00000000
		0x00000000
		0x00000000
		0x00000000
		0x00000000
		0x00000000
		0x00000000
		0x00000000
		0x00000000
		0x00000000
		0x00000000
		0x00000000
		0x00000000
		0x00000000
		0x00000000
		0x00000000
		0x00000000
		0x00000000
		0x00000000
		0x00000000
		0x00000000
		0x00000000
		0x00000000
		0x00000000
		0x00000000
		0x00000000
		0x00000000
		0x00000000
		0x00000000
		0x00000000
		0x00000000
		0x00000000
		0x00000000
		0x00000000
		0x00000000
		0x00000000
		0x00000000
		0x00000000
		0x00000000
		0x00000000
		0x00000000
		0x00000000
		0x00800000
		0x00000000
		0x00000000
		0x00000000
		0x00000000
		0x00000000
		0x00000000
		0x00000000
		0x00000000
		0x00000000
		0x00400320
		0x00000040
		0x00000000
		0x00000000
		0x00000000
		0x01000000
		0x00020003
		0x00000000
		0x00000000
		0x00000000
		0x0000002a
		0x00000015
		0x00000015
		0x0000002a
		0x00000033
		0x0000000c
		0x0000000c
		0x00000033
		0x16a4a0e6
		0x103f0000
		0x0000003f
		0x00030055
		0x03000300
		0x03000300
		0x00000300
		0x42080010
		0x00000003
		0x00000000
		0x00000000
		0x00000000
		0x00000000
		0x00000000
		0x00000000
		0x00000000
		0x00000000
		0x00000000
		0x00000000
		0x00000000
		0x00000000
		0x00000000
		0x00000000
		0x00000000
		0x00000000
		0x00000000
		0x00000000
		0x00000000
		0x00000000
		0x00000000
		0x00000000
		0x00000000
		0x00000000
		0x00000000
		0x00000000
		0x00000000
		0x00000000
		0x00000000
		0x00000000
		0x00000000
		0x00000000
		0x00000000
		0x00000000
		0x00000000
		0x00000000
		0x00000000
		0x00000000
		0x00000000
		0x00000000
		0x00000000
		0x00000000
		0x00000000
		0x00000000
		0x00000000
		0x00000000
		0x00000000
		0x00000000
		0x00000000
		0x00000000
		0x00000000
		0x00000000
		0x00000000
		0x00000000
		0x00000000
		0x00000000
		0x00000000
		0x00000000
		0x00000000
		0x00000000
		0x00000000
		0x00000000
		0x00000000
		0x00000000
		0x00000000
		0x00000000
		0x00000000
		0x00000000
		0x00000000
		0x00000000
		0x00000000
		0x00000000
		0x00000000
		0x00000000
		0x00000000
		0x00000000
		0x00000000
		0x00000000
		0x00000000
		0x00000000
		0x00000000
		0x00000000
		0x00000000
		0x00000000
		0x00000000
		0x00000000
		0x00000000
		0x00000000
		0x00000000
		0x00000000
		0x00000000
		0x00800000
		0x00000000
		0x00000000
		0x00000000
		0x00000000
		0x00000000
		0x00000000
		0x00000000
		0x00000000
		0x00000000
		0x00400320
		0x00000040
		0x00000000
		0x00000000
		0x00000000
		0x01000000
		0x00020003
		0x00000000
		0x00000000
		0x00000000
		0x0000002a
		0x00000015
		0x00000015
		0x0000002a
		0x00000033
		0x0000000c
		0x0000000c
		0x00000033
		0x1ee6b16a
		0x103f0000
		0x0000003f
		0x00030055
		0x03000300
		0x03000300
		0x00000300
		0x42080010
		0x00000003
		0x00000000
		0x00000000
		0x00000000
		0x00000000
		0x00000000
		0x00000000
		0x00000000
		0x00000000
		0x00000000
		0x00000000
		0x00000000
		0x00000000
		0x00000000
		0x00000000
		0x00000000
		0x00000000
		0x00000000
		0x00000000
		0x00000000
		0x00000000
		0x00000000
		0x00000000
		0x00000000
		0x00000000
		0x00000000
		0x00000000
		0x00000000
		0x00000000
		0x00000000
		0x00000000
		0x00000000
		0x00000000
		0x00000000
		0x00000000
		0x00000000
		0x00000000
		0x00000000
		0x00000000
		0x00000000
		0x00000000
		0x00000000
		0x00000000
		0x00000000
		0x00000000
		0x00000000
		0x00000000
		0x00000000
		0x00000000
		0x00000000
		0x00000000
		0x00000000
		0x00000000
		0x00000000
		0x00000000
		0x00000000
		0x00000000
		0x00000000
		0x00000000
		0x00000000
		0x00000000
		0x00000000
		0x00000000
		0x00000000
		0x00000000
		0x00000000
		0x00000000
		0x00000000
		0x00000000
		0x00000000
		0x00000000
		0x00000000
		0x00000000
		0x00000000
		0x00000000
		0x00000000
		0x00000000
		0x00000000
		0x00000000
		0x00000000
		0x00000000
		0x00000000
		0x00000000
		0x00000000
		0x00000000
		0x00000000
		0x00000000
		0x00000000
		0x00000000
		0x00000000
		0x00000000
		0x00000001
		0x00000000
		0x01000005
		0x04000f00
		0x00020040
		0x00020055
		0x00000000
		0x00000000
		0x00000000
		0x00000000
		0x00000000
		0x00010100
		0x00000601
		0x00000000
		0x00006400
		0x01221102
		0x00000000
		0x00031f00
		0x031f031f
		0x031f031f
		0x00030003
		0x03000300
		0x00000300
		0x01221102
		0x00000000
		0x00000000
		0x04020000
		0x00000001
		0x00008011
		0x00000011
		0x00000440
		0x00000040
		0x00004011
		0x00004011
		0x00004410
		0x00004410
		0x00004410
		0x00004410
		0x00004410
		0x00004011
		0x00004410
		0x00004011
		0x00004410
		0x00004011
		0x00004410
		0x00000000
		0x00000000
		0x00000000
		0x04000000
		0x00000000
		0x00000000
		0x00000508
		0x00000000
		0x00000000
		0x00000000
		0x00000000
		0x00000000
		0x00000000
		0xe4000000
		0x00000000
		0x00000000
		0x01010000
		0x00000000
	>;
};

